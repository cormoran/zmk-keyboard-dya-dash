#include <zephyr/dt-bindings/input/input-event-codes.h>

#include "dya_dash_v3.dtsi"


// The matrix transform for this board is 6 columns over because the left half is 5 columns wide according to the matrix.
&default_transform {
	col-offset = <6>;
};

&animation_layer_status {
	// show layer 4,5,6,7 in right side
	layer-offset = <4>;
};

&kscan_matrix {
	gpios = <&gpio1 5 (GPIO_ACTIVE_HIGH)>
	, <&xiao_d 9  (GPIO_ACTIVE_HIGH)>
	, <&gpio1 7  (GPIO_ACTIVE_HIGH)>
	, <&xiao_d 10 (GPIO_ACTIVE_HIGH)>
	, <&gpio1 1  (GPIO_ACTIVE_HIGH)>
	, <&xiao_d 2 (GPIO_ACTIVE_HIGH)>
	;
	wakeup-source;
	interrupt-gpios = <&xiao_d 8 (GPIO_ACTIVE_HIGH | GPIO_PULL_DOWN)>;
};

&right_encoder {
	status = "okay";
};