## boards/shields/dya_dash_v3/Kconfig.defconfig
```kconfig
if SHIELD_DYA_DASH_V3_RIGHT

config ZMK_KEYBOARD_NAME
    default "DYA Dash V3"
config ZMK_SPLIT_ROLE_CENTRAL
    default y
endif

if SHIELD_DYA_DASH_V3_LEFT || SHIELD_DYA_DASH_V3_RIGHT
config ZMK_SPLIT
    default y
endif
```

## boards/shields/dya_dash_v3/Kconfig.shield
```kconfig
config SHIELD_DYA_DASH_V3_LEFT
   def_bool $(shields_list_contains,dya_dash_v3_left)

config SHIELD_DYA_DASH_V3_RIGHT
   def_bool $(shields_list_contains,dya_dash_v3_right)
```

## config/west.yml
```yaml
manifest:
  version: 1.2
  defaults:
    remote: cormoran
    revision: main
  remotes:
    - name: cormoran
      url-base: https://github.com/cormoran
  projects:
    - name: zmk
      import:
        file: app/west.yml
        path-prefix: external
      clone-depth: 1
      revision: v0.3-branch+dya
    - name: zephyr
      revision: v3.5.0+zmk-fixes+nrf-half-duplex-uart
      clone-depth: 1
      import:
        path-prefix: external
        name-blocklist:
          - ci-tools
          - hal_altera
          - hal_cypress
          - hal_infineon
          - hal_microchip
          - hal_nxp
          - hal_openisa
          - hal_silabs
          - hal_xtensa
          - hal_st
          - hal_ti
          - loramac-node
          - mcuboot
          - mcumgr
          - net-tools
          - openthread
          - edtt
          - trusted-firmware-m
    - name: zmk-pmw3610-driver
      path: external/zmk-pmw3610-driver
      clone-depth: 1
    - name: zmk-feature-default-layer
      path: external/zmk-feature-default-layer
      clone-depth: 1
    - name: zmk-driver-animation
      path: external/zmk-driver-animation
      clone-depth: 1
    - name: zmk-driver-ext-power-transient
      path: external/zmk-driver-ext-power-transient
      clone-depth: 1
  self:
    path: config
```
